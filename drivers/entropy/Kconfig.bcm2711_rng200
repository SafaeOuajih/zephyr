## drivers/entropy/Kconfig.bcm2711_rng200
```kconfig
# * Copyright (c) 2024 Safae Ouajih <ouajih.safae@gmail.com>
# SPDX-License-Identifier: Apache-2.0

config ENTROPY_BMC2711_RNG200
	bool "Broadcom bcm2711 rng200 Entropy driver"
	default y
	depends on DT_HAS_BRCM_BCM2711_RNG200_ENABLED
	select ENTROPY_HAS_DRIVER
	help
	  Enable the bcm2711 rng200 entropy driver.
```

## dts/bindings/rng/brcm,bcm2711-rng200.yaml
```yaml
# Copyright (c) 2024 Safae Ouajih
# SPDX-License-Identifier: Apache-2.0

description: BRCM BCM2711 RNG (Random Number Generator)

compatible: "brcm,bcm2711-rng200"

include: base.yaml

properties:
  reg:
    required: true
```
